## firmware/bench/rsa/sdkconfig.defaults
```kconfig
CONFIG_IDF_TARGET="esp32s3"
CONFIG_ESP_DEFAULT_CPU_FREQ_MHZ_240=y
CONFIG_ESPTOOLPY_FLASHMODE_DIO=y
CONFIG_ESPTOOLPY_FLASHFREQ_80M=y
CONFIG_ESPTOOLPY_FLASHSIZE_16MB=y
CONFIG_ESP_CONSOLE_USB_SERIAL_JTAG=y
CONFIG_ESP_CONSOLE_SECONDARY_NONE=y
CONFIG_PARTITION_TABLE_CUSTOM=y
CONFIG_PARTITION_TABLE_CUSTOM_FILENAME="partitions.csv"
CONFIG_COMPILER_OPTIMIZATION_PERF=y
CONFIG_FREERTOS_HZ=1000
```

## firmware/components/w5500/Kconfig
```kconfig
menu "W5500 Ethernet"

    config W5500_DIRECT_SPI
        bool "Drive GP-SPI2 and GDMA registers directly"
        default n
        help
            Use w5500_spi_direct.c, which programs GP-SPI2 and a GDMA channel itself, instead of
            ESP-IDF's spi_master (w5500_spi_idf.c). Estimated CPU per 1,316-byte datagram: 11 us
            sent and 21 us received, against 76 us and 90 us; no spi_master code in IRAM. The
            ESP-IDF backend stays the reference until the board shows that both agree.

    config W5500_SETTINGS_NVS
        bool "Keep the eth settings in NVS"
        default y
        help
            `eth <setting>` saves to NVS, and a start reads them back. Without it the settings
            live in RAM from boot and last until reset: no NVS code, flash writes or heap after
            boot (the receiver).

    config W5500_DEFAULTS
        string "Settings over the built-in defaults"
        default ""
        help
            `eth` settings separated by ';', applied over w5500_settings_default() at boot and by
            `eth defaults`, for example "ip 192.168.77.3/24;dest 192.168.77.1:1234".

endmenu
```

## firmware/main/Kconfig.projbuild
```kconfig
menu "Payload input"
config SPI_INPUT_XIAO
    bool "Default to XIAO ESP32-S3 pins"
    default n
    help
        CLK=7 CS=1 D0/1/2/3=2/4/5/6 READY=8.
        Otherwise use DevKit pins 12/10/11/13/14/9/8.
        spipins can override either preset at runtime.
endmenu
```

## tests/moon_fill/sdkconfig.defaults
```kconfig
CONFIG_IDF_TARGET="esp32s3"
CONFIG_ESPTOOLPY_FLASHSIZE_4MB=y
CONFIG_ESP_DEFAULT_CPU_FREQ_MHZ_240=y
CONFIG_ESP_CONSOLE_UART_DEFAULT=y
CONFIG_PARTITION_TABLE_SINGLE_APP=y
```

## tests/rx_bench/sdkconfig.defaults
```kconfig
CONFIG_IDF_TARGET="esp32s3"
CONFIG_ESPTOOLPY_FLASHSIZE_8MB=y
CONFIG_ESP_DEFAULT_CPU_FREQ_MHZ_240=y
CONFIG_COMPILER_OPTIMIZATION_PERF=y
CONFIG_SPIRAM=y
CONFIG_SPIRAM_MODE_OCT=y
CONFIG_SPIRAM_SPEED_80M=y
CONFIG_ESP_CONSOLE_USB_SERIAL_JTAG=y
```

## tests/rx_fec_bench/sdkconfig.defaults
```kconfig
CONFIG_IDF_TARGET="esp32s3"
CONFIG_ESP_DEFAULT_CPU_FREQ_MHZ_240=y
CONFIG_COMPILER_OPTIMIZATION_PERF=y
CONFIG_ESP_MAIN_TASK_STACK_SIZE=16384
CONFIG_ESP_CONSOLE_USB_SERIAL_JTAG=y
CONFIG_ESPTOOLPY_FLASHSIZE_4MB=y
CONFIG_ESP_TASK_WDT_EN=n
```

## tests/rx_stream/sdkconfig.defaults
```kconfig
CONFIG_IDF_TARGET="esp32s3"
CONFIG_ESPTOOLPY_FLASHSIZE_8MB=y
CONFIG_ESP_DEFAULT_CPU_FREQ_MHZ_240=y
CONFIG_COMPILER_OPTIMIZATION_PERF=y
CONFIG_SPIRAM=y
CONFIG_SPIRAM_MODE_OCT=y
CONFIG_SPIRAM_SPEED_80M=y
CONFIG_ESP_CONSOLE_USB_SERIAL_JTAG=y
CONFIG_ESP_PHY_ENABLE_CERT_TEST=y
CONFIG_ESP_PHY_CALIBRATION_AND_DATA_STORAGE=n
CONFIG_ESP_WIFI_STATIC_RX_BUFFER_NUM=2
CONFIG_ESP_WIFI_DYNAMIC_RX_BUFFER_NUM=8
CONFIG_ESP_WIFI_DYNAMIC_TX_BUFFER_NUM=8
CONFIG_ESP_WIFI_AMPDU_TX_ENABLED=n
CONFIG_ESP_WIFI_AMPDU_RX_ENABLED=n
CONFIG_ESP_WIFI_MGMT_SBUF_NUM=8
CONFIG_ESP_WIFI_NVS_ENABLED=n
CONFIG_ESP_WIFI_IRAM_OPT=n
CONFIG_ESP_WIFI_RX_IRAM_OPT=n
CONFIG_SPIRAM_TRY_ALLOCATE_WIFI_LWIP=y
CONFIG_HEAP_PLACE_FUNCTION_INTO_FLASH=y
CONFIG_GDMA_CTRL_FUNC_IN_IRAM=y
CONFIG_ESP_INT_WDT_TIMEOUT_MS=800
```

## tests/shaper_axes/sdkconfig.defaults
```kconfig
CONFIG_IDF_TARGET="esp32s3"
CONFIG_ESP_MAIN_TASK_STACK_SIZE=8192
CONFIG_ESP_CONSOLE_UART_DEFAULT=y
CONFIG_ESP_CONSOLE_USB_SERIAL_JTAG=n
CONFIG_ESPTOOLPY_FLASHSIZE_4MB=y
```

## tests/shaper_pie/sdkconfig.defaults
```kconfig
CONFIG_IDF_TARGET="esp32s3"
CONFIG_ESPTOOLPY_FLASHSIZE_4MB=y
CONFIG_ESP_DEFAULT_CPU_FREQ_MHZ_240=y
CONFIG_COMPILER_OPTIMIZATION_PERF=y
CONFIG_ESP_TASK_WDT_EN=n
CONFIG_ESP_INT_WDT=n
```
